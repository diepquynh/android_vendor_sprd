; list of the registers' physical address and virtual address

global &AHB_BASE
global &INTC0_BASE
global &GPTIMER_BASE
global &ADI_BASE
global &GPIO_BASE
global &EIC_BASE
global &GREG_BASE

global &AHB_PHY_BASE
global &INTC0_PHY_BASE
global &GPTIMER_PHY_BASE
global &ADI_PHY_BASE
global &GPIO_PHY_BASE
global &EIC_PHY_BASE
global &GREG_PHY_BASE


&AHB_BASE= 0xf1400000
&INTC0_BASE= 0xf1254000
&GPTIMER_BASE= 0xf1258000
&ADI_BASE= 0xf1260000
&GPIO_BASE= 0xf1298000
&EIC_BASE= 0xf129c000
&GREG_BASE= 0xf1320000

&AHB_PHY_BASE= 0x20900000
&INTC0_PHY_BASE= 0x40003000
&GPTIMER_PHY_BASE= 0x41000000
&ADI_PHY_BASE= 0x42000000
&GPIO_PHY_BASE= 0x4a000000
&EIC_PHY_BASE= 0x4a001000
&GREG_PHY_BASE= 0x4b000000
